RS BIT P0.0
EN BIT P0.1

ADC_CS BIT P1.0
ADC_RD BIT P1.1
ADC_WR BIT P1.2
ADC_INTR BIT P1.3

SUBB1_H EQU 30H
SUBB1_L EQU 31H
SUBB2_H EQU 32H
SUBB2_L EQU 33H
SUBB_RS_H EQU 34H
SUBB_RS_L EQU 35H

DIV_RS EQU 36H
DIV_RM EQU 37H

FL_S1 EQU 38H
FL_S2 EQU 39H
FL_INT1 EQU 40H
FL_FL1 EQU 41H

ORG 00H
LJMP MAIN

ORG 30H
MOV SUBB1_H, 	#0		;	S1 - 8HB
MOV SUBB1_L, 	#0		;	S1 - 8LB
MOV SUBB2_H, 	#0		;   S2 - 8HB
MOV SUBB2_L, 	#0		;   S2 - 8LB
MOV SUBB_RS_H, 	#0 		; 	RS - 8HB
MOV SUBB_RS_L, 	#0 		; 	RS - 8LB

MOV DIV_RS, #0			; 	DIV RESULT
MOV DIV_RM, #0			; 	DIV REAMAINS

MOV FL_S1, 		#0		; 	S1 
MOV FL_S2, 		#0 		; 	S2
MOV FL_INT1, 	#0 		; 	INT1
MOV FL_FL1, 	#0 		; 	FLOAT.1


ORG 50H
MAIN:
	MOV TMOD, #1H		; Timer 0 mode 1
	
	; LCD INIT
	MOV A, #38H			; LCD1602
	CALL LCD_WR_CMD
	MOV A, #0CH			; TURN ON LCD
	CALL LCD_WR_CMD
	MOV A, #1H			; CLEAR LCD
	CALL LCD_WR_CMD

	; ADC INIT
	SETB ADC_CS
	SETB ADC_WR
	SETB ADC_RD
	
MAIN_LOOP:
	MOV A, #1H		; CLEAR LCD
	CALL LCD_WR_CMD
	
	; SEND CONTEXT 1
	MOV R0, #0
	MOV DPTR, #LCD_CONTEXT_1
LOOP_SEND_CONTEXT_1:
	MOV A, R0
	MOVC A, @A+DPTR
	CALL LCD_WR_DATA
	INC R0
	CJNE R0, #9, LOOP_SEND_CONTEXT_1
	
	; READ ADC
	CALL READ_ADC
	MOV FL_S1, A
	
	; CONVERT MG/L 
	CALL FLOATING_POINT
	MOV A, FL_INT1				; SEND INT1
	ADD A, #48	
	CALL LCD_WR_DATA
	
	MOV A, #44					; CHARACTER ','
	CALL LCD_WR_DATA
	
	MOV A, FL_FL1				; SEND FLOAT.1
	ADD A, #48	
	CALL LCD_WR_DATA

   	; SEND CONTEXT 2
	MOV R0, #0
	MOV DPTR, #LCD_CONTEXT_2
LOOP_SEND_CONTEXT_2:
	MOV A, R0
	MOVC A, @A+DPTR
	CALL LCD_WR_DATA
	INC R0
	CJNE R0, #5, LOOP_SEND_CONTEXT_2

	; DELAY 1S
	MOV R7, #250
	CALL DELAY
	MOV R7, #250
	CALL DELAY
	MOV R7, #250
	CALL DELAY
	MOV R7, #250
	CALL DELAY

	LJMP MAIN_LOOP

LCD_WR_CMD:
	MOV P3, A
	CLR RS
	CLR EN
	SETB EN
	MOV R7, #30 ; DELAY 30MS
	CALL DELAY
	RET

LCD_WR_DATA:
	MOV P3, A
	SETB RS
	CLR EN
	SETB EN
	MOV R7, #1 ; DELAY 1MS
	CALL DELAY
	RET

DELAY:
	; R7 - time ms	
DELAY_LOOP:
	MOV TL0, #18H	; 1MS	
	MOV TH0, #0FCH
	SETB TR0
	JNB TF0, $
	CLR TR0
	CLR TF0
	DJNZ R7, DELAY_LOOP
	RET

READ_ADC:
	CLR ADC_CS
	CLR ADC_WR
	SETB ADC_WR
	JNB ADC_INTR, $
	CLR ADC_RD
	MOV A, P2
	;SETB ADC_CS
	;SETB ADC_WR
	;SETB ADC_RD
	RET

FLOATING_POINT:
	; RESET VALUE
	MOV FL_INT1, #0
	MOV FL_FL1, #0
	
	MOV FL_S2, #255
	
	; INT1
	MOV A, FL_S1
	MOV B, #10
	MUL AB
	MOV SUBB1_H, B
	MOV SUBB1_L, A
	MOV SUBB2_H, #0
	MOV SUBB2_L, #255
	CALL DIV16
	MOV FL_INT1, DIV_RS		; SAVE RESULT INT1

	; FLOAT.1
	MOV A, FL_S1
	MOV B, #10
	MUL AB
	MOV SUBB1_H, B
	MOV SUBB1_L, A
	
	MOV A, FL_INT1
	MOV B, #255
	MUL AB
	MOV SUBB2_H, B
	MOV SUBB2_L, A
	CALL SUBB16
	
	MOV A, SUBB_RS_L
	MOV B, #10
	MUL AB
	MOV SUBB1_H, B
	MOV SUBB1_L, A
	MOV SUBB2_H, #0
	MOV SUBB2_L, #255
	CALL DIV16	 
	MOV FL_FL1, DIV_RS		; SAVE RESULT FLOAT.1

	RET

SUBB16:
	; S1:  SUBB1_H SUBB1_L
	; S2:  SUBB2_H SUBB2_L
	; RS:  SUBB_RS_H SUBB_RS_L
	CLR C
	MOV A, SUBB1_L
	MOV B, SUBB2_L																											  
	SUBB A, B
	MOV SUBB_RS_L, A	; RS - 8LB
	
	MOV A, SUBB1_H
	MOV B, SUBB2_H
	SUBB A, B
	MOV SUBB_RS_H, A	; RS - 8HB
	RET


DIV16:
	MOV SUBB_RS_H, #0	;	RS - 8HB
	MOV SUBB_RS_L, #0	;	RS - 8LB
	MOV DIV_RS, #0		; 	
	MOV DIV_RM, #0		; 	
DIV16_LOOP:
	CALL SUBB16
	JC END_DIV16
	INC DIV_RS			; 
	
	MOV R1, SUBB_RS_H
	MOV R2, SUBB_RS_L
	
	MOV SUBB1_H, R1
	MOV SUBB1_L, R2	

	CJNE R1, #0, DIV16_LOOP
	MOV A, R2
	MOV B, SUBB2_L
	SUBB A, B
	JNC DIV16_LOOP
	MOV	DIV_RM, R2	
END_DIV16:
	RET

LCD_CONTEXT_1: DB 'Concent: '
LCD_CONTEXT_2: DB ' MG/L'

END